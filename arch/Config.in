## arch/Config.in
```kconfig
menu "Target options"

config BR2_ARCH_IS_64
	bool

config BR2_KERNEL_64_USERLAND_32
	bool

config BR2_SOFT_FLOAT
	bool

config BR2_ARCH_HAS_MMU_MANDATORY
	bool

config BR2_ARCH_HAS_MMU_OPTIONAL
	bool

choice
	prompt "Target Architecture"
	default BR2_i386
	help
	  Select the target architecture family to build for.

config BR2_arm
	bool "ARM (little endian)"
	# MMU support is set by the subarchitecture file, arch/Config.in.arm
	help
	  ARM is a 32-bit reduced instruction set computer (RISC) instruction
	  set architecture (ISA) developed by ARM Holdings. Little endian.
	  http://www.arm.com/
	  http://en.wikipedia.org/wiki/ARM

config BR2_i386
	bool "i386"
	select BR2_ARCH_HAS_MMU_MANDATORY
	help
	  Intel i386 architecture compatible microprocessor
	  http://en.wikipedia.org/wiki/I386

config BR2_x86_64
	bool "x86_64"
	select BR2_ARCH_IS_64
	select BR2_ARCH_HAS_MMU_MANDATORY
	help
	  x86-64 is an extension of the x86 instruction set (Intel i386
	  architecture compatible microprocessor).
	  http://en.wikipedia.org/wiki/X86_64

endchoice

# The following string values are defined by the individual
# Config.in.$ARCH files
config BR2_ARCH
	string

config BR2_ENDIAN
	string

config BR2_GCC_TARGET_ARCH
	string

config BR2_GCC_TARGET_ABI
	string

config BR2_GCC_TARGET_CPU
	string

config BR2_GCC_TARGET_CPU_REVISION
	string

# The value of this option will be passed as --with-fpu=<value> when
# building gcc (internal backend) or -mfpu=<value> in the toolchain
# wrapper (external toolchain)
config BR2_GCC_TARGET_FPU
	string

# The value of this option will be passed as --with-float=<value> when
# building gcc (internal backend) or -mfloat-abi=<value> in the toolchain
# wrapper (external toolchain)
config BR2_GCC_TARGET_FLOAT_ABI
	string

# The value of this option will be passed as --with-mode=<value> when
# building gcc (internal backend) or -m<value> in the toolchain
# wrapper (external toolchain)
config BR2_GCC_TARGET_MODE
	string

# Must be selected by binary formats that support shared libraries.
config BR2_BINFMT_SUPPORTS_SHARED
	bool

# Set up target binary format
choice
	prompt "Target Binary Format"
	default BR2_BINFMT_ELF if !(BR2_bfin || BR2_m68k)

config BR2_BINFMT_ELF
	bool "ELF"
	depends on !BR2_bfin && !BR2_m68k
	select BR2_BINFMT_SUPPORTS_SHARED
	help
	  ELF (Executable and Linkable Format) is a format for libraries and
	  executables used across different architectures and operating
	  systems.

endchoice

if BR2_arm
source "arch/Config.in.arm"
endif

if BR2_i386 || BR2_x86_64
source "arch/Config.in.x86"
endif

endmenu # Target options
```

## boot/Config.in
```kconfig
menu "Bootloaders"

source "boot/grub2/Config.in"
source "boot/syslinux/Config.in"

endmenu
```

## configs/cargos_rpi2_defconfig
```kconfig
BR2_arm=y
BR2_cortex_a7=y
BR2_ARM_EABIHF=y
BR2_ARM_FPU_NEON_VFPV4=y
BR2_CCACHE=y
BR2_OPTIMIZE_2=y
BR2_ENABLE_SSP=y
BR2_TOOLCHAIN_BUILDROOT_VENDOR="cargos"
BR2_KERNEL_HEADERS_VERSION=y
BR2_DEFAULT_KERNEL_VERSION="4.1.5"
BR2_PACKAGE_HOST_LINUX_HEADERS_CUSTOM_4_1=y
BR2_GLIBC_VERSION_2_21=y
BR2_BINUTILS_VERSION_2_25=y
BR2_TARGET_GENERIC_HOSTNAME="cargos.localdomain"
BR2_TARGET_GENERIC_ISSUE="Welcome to CargOS-$(BR2_VERSION)!"
BR2_TARGET_GENERIC_PASSWD_SHA256=y
BR2_ROOTFS_DEVICE_CREATION_DYNAMIC_EUDEV=y
BR2_ROOTFS_SKELETON_CUSTOM=y
BR2_ROOTFS_SKELETON_CUSTOM_PATH="system/skeleton-cargos"
BR2_TARGET_TZ_INFO=y
BR2_TARGET_LOCALTIME="Europe/Berlin"
BR2_LINUX_KERNEL=y
BR2_LINUX_KERNEL_CUSTOM_GIT=y
BR2_LINUX_KERNEL_CUSTOM_REPO_URL="git://github.com/raspberrypi/linux.git"
BR2_LINUX_KERNEL_CUSTOM_REPO_VERSION="rpi-4.1.y"
BR2_LINUX_KERNEL_USE_CUSTOM_CONFIG=y
BR2_LINUX_KERNEL_CUSTOM_CONFIG_FILE="board/cargos/rpi2/linux-4.0.config"
BR2_LINUX_KERNEL_ZIMAGE=y
BR2_PACKAGE_BUSYBOX_SHOW_OTHERS=y
BR2_PACKAGE_BINUTILS=y
BR2_PACKAGE_BINUTILS_TARGET=y
BR2_PACKAGE_GAWK=y
BR2_PACKAGE_BTRFS_PROGS=y
BR2_PACKAGE_E2FSPROGS_E4DEFRAG=y
BR2_PACKAGE_E2FSPROGS_RESIZE2FS=y
BR2_PACKAGE_UNIONFS=y
BR2_PACKAGE_RPI_FIRMWARE=y
BR2_PACKAGE_CRYPTSETUP=y
BR2_PACKAGE_IPTABLES=y
BR2_PACKAGE_BASH=y
BR2_PACKAGE_DIALOG=y
BR2_PACKAGE_RCORDER=y
BR2_PACKAGE_COREUTILS=y
BR2_PACKAGE_KMAPS=y
BR2_PACKAGE_PKGSRC=y
BR2_PKGSRC_ARCH="rpi2"
BR2_PACKAGE_PROCPS_NG=y
```

## configs/cargos_x86_64_defconfig
```kconfig
BR2_x86_64=y
BR2_OPTIMIZE_2=y
BR2_SSP_ALL=y
BR2_TOOLCHAIN_BUILDROOT_VENDOR="cargos"
BR2_PACKAGE_HOST_LINUX_HEADERS_CUSTOM_4_1=y
BR2_GLIBC_VERSION_2_22=y
BR2_BINUTILS_VERSION_2_25_X=y
BR2_ENABLE_LOCALE_PURGE=y
BR2_ENABLE_LOCALE_WHITELIST="C en_US"
BR2_TARGET_GENERIC_HOSTNAME="cargos.localdomain"
BR2_TARGET_GENERIC_ISSUE="Welcome to CargOS-$(BR2_VERSION)!"
BR2_TARGET_GENERIC_PASSWD_SHA256=y
BR2_ROOTFS_DEVICE_CREATION_DYNAMIC_EUDEV=y
BR2_ROOTFS_SKELETON_CUSTOM=y
BR2_ROOTFS_SKELETON_CUSTOM_PATH="system/skeleton-cargos"
BR2_TARGET_TZ_INFO=y
BR2_TARGET_LOCALTIME="Europe/Berlin"
BR2_ROOTFS_POST_IMAGE_SCRIPT="support/scripts/cargos-iso.sh"
BR2_LINUX_KERNEL=y
BR2_LINUX_KERNEL_CUSTOM_VERSION=y
BR2_LINUX_KERNEL_CUSTOM_VERSION_VALUE="4.1.17"
BR2_LINUX_KERNEL_PATCH="http://nerd.hu/pax-linux-4.1.15-test24.patch http://nerd.hu/grsec-4.1.15-3.1-201509112213.patch"
BR2_LINUX_KERNEL_USE_CUSTOM_CONFIG=y
BR2_LINUX_KERNEL_CUSTOM_CONFIG_FILE="board/cargos/x86/linux-4.0.config"
BR2_PACKAGE_BUSYBOX_SHOW_OTHERS=y
BR2_PACKAGE_BINUTILS=y
BR2_PACKAGE_BINUTILS_TARGET=y
BR2_PACKAGE_GAWK=y
BR2_PACKAGE_E2FSPROGS=y
BR2_PACKAGE_E2FSPROGS_E4DEFRAG=y
BR2_PACKAGE_E2FSPROGS_RESIZE2FS=y
BR2_PACKAGE_XFSPROGS=y
BR2_PACKAGE_CRYPTSETUP=y
BR2_PACKAGE_ZLIB=y
BR2_PACKAGE_IPTABLES=y
BR2_PACKAGE_BASH=y
BR2_PACKAGE_DIALOG=y
BR2_PACKAGE_RCORDER=y
BR2_PACKAGE_KMAPS=y
BR2_PACKAGE_KMOD_TOOLS=y
BR2_PACKAGE_PKGSRC=y
BR2_PACKAGE_PROCPS_NG=y
BR2_TARGET_ROOTFS_SQUASHFS=y
BR2_TARGET_ROOTFS_SQUASHFS4_XZ=y
# BR2_TARGET_ROOTFS_TAR is not set
```

## configs/parcel_x86_64_defconfig
```kconfig
BR2_x86_64=y
BR2_OPTIMIZE_2=y
BR2_SSP_ALL=y
BR2_TOOLCHAIN_BUILDROOT_VENDOR="cargos"
BR2_KERNEL_HEADERS_4_1=y
BR2_ENABLE_LOCALE_PURGE=y
BR2_ENABLE_LOCALE_WHITELIST="C en_US"
BR2_TARGET_GENERIC_HOSTNAME="parcel.localdomain"
BR2_TARGET_GENERIC_ISSUE="Welcome to Parcel-$(BR2_VERSION)!"
BR2_TARGET_GENERIC_PASSWD_SHA256=y
BR2_ROOTFS_DEVICE_CREATION_STATIC=y
BR2_ROOTFS_DEVICE_TABLE="system/device_table_parcel.txt"
BR2_ROOTFS_SKELETON_CUSTOM=y
BR2_ROOTFS_SKELETON_CUSTOM_PATH="system/skeleton-parcel"
BR2_PACKAGE_BUSYBOX_CONFIG="package/busybox/busybox-parcel.config"
# BR2_TARGET_ROOTFS_TAR is not set
BR2_TARGET_ROOTFS_DOCKER=y
```

## fs/Config.in
```kconfig
menu "Filesystem images"

source "fs/squashfs/Config.in"
source "fs/tar/Config.in"
source "fs/docker/Config.in"

endmenu
```

## fs/docker/Config.in
```kconfig
config BR2_TARGET_ROOTFS_DOCKER
	bool "import the root filesystem to docker"
	default n

config BR2_TARGET_ROOTFS_DOCKER_NAME
        string "name of the docker image"
        depends on BR2_TARGET_ROOTFS_DOCKER
        default "parcel"

config BR2_TARGET_ROOTFS_DOCKER_TAR_OPTS
        string "extra opts for tar for creating the docker image"
        depends on BR2_TARGET_ROOTFS_DOCKER
        default ""
```

## package/Config.in
```kconfig
menu "Target packages"

	source "package/skeleton/Config.in"
	source "package/busybox/Config.in"

menu "Compressors and decompressors"
	source "package/xz/Config.in"
endmenu

menu "Crypto"
	source "package/ca-certificates/Config.in"
endmenu

menu "Debugging, profiling and benchmark"
	source "package/gdb/Config.in"
endmenu

menu "Development tools"
	source "package/binutils/Config.in"
	source "package/flex/Config.in"
	source "package/egcc/Config.in"
	source "package/gawk/Config.in"
	source "package/gperf/Config.in"
	source "package/gettext/Config.in"
	source "package/libtool/Config.in"
	source "package/pkgconf/Config.in"
endmenu

menu "Filesystem and flash utilities"
	source "package/e2fsprogs/Config.in"
	source "package/squashfs/Config.in"
	source "package/xfsprogs/Config.in"
endmenu

menu "Hardware handling"
menu "Firmware"
	source "package/linux-firmware/Config.in"
	source "package/rpi-firmware/Config.in"
endmenu
	source "package/acpid/Config.in"
	source "package/cryptsetup/Config.in"
	source "package/eudev/Config.in"
	source "package/lvm2/Config.in"
	source "package/udev/Config.in"
endmenu

menu "Libraries"

menu "Compression and decompression"
	source "package/lzip/Config.in"
	source "package/zlib/Config.in"
endmenu

menu "Other"
	source "package/musl-compat-headers/Config.in"
	source "package/tzdata/Config.in"
endmenu

menu "Text and terminal handling"
	source "package/ncurses/Config.in"
	source "package/popt/Config.in"
	source "package/readline/Config.in"
endmenu

endmenu

menu "Networking applications"
	source "package/iptables/Config.in"
	source "package/iproute2/Config.in"
endmenu

menu "Shell and utilities"
comment "Shells"
	source "package/bash/Config.in"
comment "Utilities"
	source "package/dialog/Config.in"
endmenu

menu "System tools"
	source "package/rcorder/Config.in"
	source "package/acl/Config.in"
	source "package/attr/Config.in"
	source "package/coreutils/Config.in"
	source "package/kmaps/Config.in"
	source "package/kmod/Config.in"
	source "package/pkgsrc/Config.in"
	source "package/procps-ng/Config.in"
	source "package/util-linux/Config.in"

endmenu
endmenu
```

## package/Config.in.host
```kconfig
menu "Host utilities"

	source "package/e2fsprogs/Config.in.host"
	source "package/squashfs/Config.in.host"
	source "package/util-linux/Config.in.host"

endmenu
```

## package/egcc/Config.in
```kconfig
config BR2_PACKAGE_EGCC
	bool "egcc"
	depends on BR2_USE_WCHAR
	depends on BR2_USE_MMU # fork()
	help
	  All of the basic file/text/shell utilities.  These are the
	  core utilities which are expected to exist on every system.
	  BusyBox implements many of the most common.

	  Things like:
	  - chmod, cp, dd, dir, ls, etc...
	  - sort, tr, head, tail, wc, etc...
	  - whoami, who, etc...

	  http://www.gnu.org/software/egcc/

comment "egcc needs a toolchain w/ wchar"
	depends on BR2_USE_MMU
	depends on !BR2_USE_WCHAR
```

## package/pkgsrc/Config.in
```kconfig
config BR2_PACKAGE_PKGSRC
	bool "pkgsrc"
	help
	  pkgsrc bootstrap tarball

	  http://www.pkgsrc.org/

config BR2_PKGSRC_ARCH
	string "pkgsrch architecture"
	default BR2_ARCH
	depends on BR2_PACKAGE_PKGSRC
	help
	  Package architecture, in case it differs from the platform name.
```

## toolchain/Config.in
```kconfig
menu "Toolchain"

# Invisible option that makes sure the toolchain package always gets
# built
config BR2_TOOLCHAIN
	bool
	default y

# Should be selected for glibc or eglibc
config BR2_TOOLCHAIN_USES_GLIBC
	bool
	select BR2_USE_WCHAR
	select BR2_ENABLE_LOCALE
	select BR2_TOOLCHAIN_HAS_THREADS
	select BR2_TOOLCHAIN_HAS_THREADS_DEBUG
	select BR2_TOOLCHAIN_HAS_THREADS_NPTL
	select BR2_TOOLCHAIN_HAS_SHADOW_PASSWORDS

config BR2_TOOLCHAIN_USES_MUSL
	bool
	select BR2_USE_WCHAR
	select BR2_ENABLE_LOCALE
	select BR2_TOOLCHAIN_HAS_THREADS
	select BR2_TOOLCHAIN_HAS_THREADS_DEBUG
	select BR2_TOOLCHAIN_HAS_THREADS_NPTL

choice
	prompt "Toolchain type"
	help
	  Select whether to use the toolchain provided by buildroot
	  or an external toolchain.

	  Some vendors provide toolchains in binary form, some in
	  source form.

config BR2_TOOLCHAIN_BUILDROOT
	bool "Buildroot toolchain"
	depends on !BR2_bfin
	select BR2_TOOLCHAIN_HAS_SHADOW_PASSWORDS
endchoice

source "toolchain/toolchain-buildroot/Config.in"
source "toolchain/toolchain-common.in"

endmenu
```
